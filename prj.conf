## CMakeLists.txt
```
cmake_minimum_required(VERSION 3.28.3)
project(FlexiFirm)
set(FIRMWARE_NAME firmware)

if (NOT DEFINED TARGET_CPU)
    message(FATAL_ERROR "TARGET_CPU not defined!")
endif()


if(TARGET_CPU STREQUAL "arm-m33")
    add_subdirectory(baremetal/arm-m33)
elseif(TARGET_CPU STREQUAL "arm-m3-qemu")
    add_subdirectory(baremetal/arm-m3)
elseif(TARGET_CPU STREQUAL "x86")
    add_subdirectory(tests)
else()
    message(FATAL_ERROR "Unsupported TARGET_CPU: ${TARGET_CPU}")
endif()
```

## prj.conf
```kconfig
CONFIG_NEWLIB_LIBC=y
CONFIG_PICOLIBC=n
CONFIG_LOG=y
```

## src/main.c
```c
#include <zephyr/kernel.h>
#include <zephyr/logging/log.h>

LOG_MODULE_REGISTER(main, LOG_LEVEL_INF);

#define SLEEP_TIME_MS   1000
int main(void) 
{
    LOG_INF("Entering main\n");
    while (1) 
    {
        k_msleep(SLEEP_TIME_MS);
    }
    
    return 0;
}
```

## src/arm_startup.c
```c
int main(void);

__attribute__((naked, noreturn)) void _reset(void)
{
    extern long _sbss, _ebss, _sdata, _edata, _sidata;
    for (long *dst = &_sbss; dst < &_ebss; dst++)
    {
        *dst = 0;
    }
    for (long *dst = &_sdata, *src = &_sidata; dst < &_edata;)
    {
        *dst++ = *src++;
    }

    main();

    while (1)
    { }
}

extern void _estack(void);

__attribute__((section(".vectors"))) void (*const tab[16+91])(void) = { 
    _estack, 
    _reset

    // rest of the handlers here   
};
```
